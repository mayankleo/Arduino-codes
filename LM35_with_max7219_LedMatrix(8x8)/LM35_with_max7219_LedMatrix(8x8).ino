
#include <LedControl.h>
#include <stdlib.h>
#define minus 10
#define error 11

int DIN = 11;
int CS =  10;
int CLK = 13;

int Value;
float milliVolt;
int temp;

LedControl lc=LedControl(DIN,CLK,CS,0);

byte displayDigits[][8] = {
    {0xe0,0xa0,0xa0,0xa0,0xa0,0xa0,0xe0,0x00}, //0
    {0x20,0x60,0x20,0x20,0x20,0x20,0x20,0x00}, //1 
    {0xe0,0x20,0x20,0xe0,0x80,0x80,0xe0,0x00}, //2
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    {0xc3,0xe7,0x7e,0x3c,0x3c,0x7e,0xe7,0xc3}  //error
};

byte *append(int a, int b){
    byte *res = (byte*) calloc(8, sizeof(byte));
    if (res == NULL) {
        return displayDigits[error];
    }
    for(int i=0; i<8; i++){
        res[i]=displayDigits[a][i]|displayDigits[b][i]>>4;
    }
    return res;
}

void display(int N){
    if(N<-9 || N>99){
        printByte(error);
    }
    if(N<0){
        printByte(append(minus, -N));
    } else {
        printByte(append(N/10, N%10));
    }
}

void setup(){
 lc.shutdown(0,false);       
 lc.setIntensity(0,1);      //brightness 1-15(right now it is set as 1)
 lc.clearDisplay(0); 
 Serial.begin(9600);  
}

void loop(){ 
    Value = analogRead(A0);
    milliVolt = ((Value * 5000.0) / 1024); //change 5000mV according to your AREF voltage for accuracy
    temp = milliVolt/10;
    display(temp);
    Serial.println(temp);
    delay(1000);
}

void printByte(byte character [])
{
  for(int i=0; i<8; i++) lc.setRow(0,i,character[i]);
}
